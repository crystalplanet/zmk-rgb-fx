## Kconfig
```kconfig
# Copyright (c) 2024 Kuba Birecki
# SPDX-License-Identifier: MIT

menuconfig ZMK_RGB_FX
    bool "RGB Animations"
    depends on LED_STRIP
    help
        Enable RGB animations.

menuconfig ZMK_RGB_FX_FPS
    int "RGB effect FPS"
    range 1 60
    default 30
    help
        Set the FPS at which the RGB animations should run, or to be more specific,
        it's the maximum speed at which active animations can request new frames
        to be rendered.

menuconfig ZMK_RGB_FX_PIXEL_DISTANCE
    bool "Generate a lookup table for distances between pixels"
    default y
    help
        This setting will generate a lookup table containing the relative distances
        between all pixels during system initialization, in order to improve performance
        during runtime.

        The size of the lookup table is: (n-1) + (n-2) + ... + 1 bytes
        Where `n` is the number of individual color pixels. For example:
        60  RGB LEDs -> 180 pixels -> 16 110 bytes
        100 RGB LEDs -> 300 pixels -> 44 850 bytes

        If you're not using animations that rely on relative positions,
        you can disable this setting to save space.
```

## dts/bindings/behaviors/zmk,behavior-rgb-fx.yaml
```yaml
# Copyright (c) 2024 Kuba Birecki
# SPDX-License-Identifier: MIT

description: RGB FX Action

compatible: "zmk,behavior-rgb-fx"

include: one_param.yaml
```

## dts/bindings/rgb-fx-base.yaml
```yaml
# Copyright (c) 2024 Kuba Birecki
# SPDX-License-Identifier: MIT

properties:
  pixels:
    type: array
    required: true
    description: |
      Pixel positions to which the RGB effects should apply.

  blending-mode:
    type: string
    enum:
      - "normal"
      - "multiply"
      - "lighten"
      - "darken"
      - "screen"
      - "subtract"
    default: "normal"
    description: |
      Blending mode for the effects to use during render.
```

## dts/bindings/zmk,rgb-fx-bt-indicator.yaml
```yaml
# Copyright (c) 2024 Kuba Birecki
# SPDX-License-Identifier: MIT

description: |
  Animates a linear gradient alternating between the given colors.

compatible: "zmk,rgb-fx-bt-indicator"

include: rgb-fx-base.yaml

properties:
  profile-index:
    type: int
    required: true
    description: |
      The zero-based bluetooth profile index this indicator is responsible for.

  color:
    type: int
    required: true
    description: |
      Main indicator color in HSL format. Indicated successful connection.
      Will be used as the default for all other sates as well unless optional values are provided.

  pairing-color:
    type: int
    required: false
    description: |
      Optional alternate color for when the bluetooth profile is in pairing mode.

  connecting-color:
    type: int
    required: false
    description: |
      Optional alternate color for when the bluetooth profile is in a (re)connecting state.

  backdrop-pixels:
    type: array
    required: false
    description: |
      Optional pixel mask to determine a backdrop for the effect.
      Can be useful to improve the indicators visibility in particularly busy settings.

  backdrop-color:
    type: int
    required: false
    description: Backdrop color in HSL format.

  no-blink:
    type: boolean
    description: |
      Disables blinking for the indicator - in case you want to rely solely on colors
      to highlight different states.
```

## dts/bindings/zmk,rgb-fx-compose.yaml
```yaml
# Copyright (c) 2024 Kuba Birecki
# SPDX-License-Identifier: MIT

description: |
  Higher-order effect which allows for composing other effect drivers
  and using different blending modes.

compatible: "zmk,rgb-fx-compose"

properties:
  fx:
    type: phandles
    required: true
    description: |
      Effects to be combined.
```

## dts/bindings/zmk,rgb-fx-control-group.yaml
```yaml
# Copyright (c) 2024 Kuba Birecki
# SPDX-License-Identifier: MIT

description: |
  Higher-order animation which allows for controlling effect drivers
  placed underneath it by turning them on and off, cycling though them,
  or changing the brightness.

compatible: "zmk,rgb-fx-control-group"

properties:
  fx:
    type: phandles
    required: true
    description: |
      Effects controlled by this group.

  brightness-steps:
    type: int
    default: 5
    description: |
      How many brightness steps should be supported.
```

## dts/bindings/zmk,rgb-fx-linear-gradient.yaml
```yaml
# Copyright (c) 2024 Kuba Birecki
# SPDX-License-Identifier: MIT

description: |
  Animates a linear gradient alternating between the given colors.

compatible: "zmk,rgb-fx-linear-gradient"

include: rgb-fx-base.yaml

properties:
  colors:
    type: array
    required: true
    description: |
      Gradient colors

  angle:
    type: int
    default: 0
    description: |
      Gradient angle expressed in degrees. 0 degrees gives a horizontal gradient from left to right.

  gradient-width:
    type: int
    default: 255
    description: |
      The total width of the entire gradient (all colors!).
      This is relative to the pixel-coordinate system.

  duration:
    type: int
    default: 0
    description: |
      Time it takes for the gradient to animate back to its original position.
      Set to 0 for a static gradient.

  use-rgb-interpolation:
    type: boolean
    description: |
      Gradients use HSL interpolation by default. Set this setting to true to use RGB instead.
```

## dts/bindings/zmk,rgb-fx-pixel.yaml
```yaml
# Copyright (c) 2024 Kuba Birecki
# SPDX-License-Identifier: MIT

description: Pixel configuration

compatible: "zmk,rgb-fx-pixel"

pixel-cells:
  - position_x
  - position_y
```

## dts/bindings/zmk,rgb-fx-ripple.yaml
```yaml
# Copyright (c) 2024 Kuba Birecki
# SPDX-License-Identifier: MIT

description: |
  Animated 'ripples' trigered by key presses.

compatible: "zmk,rgb-fx-ripple"

include: rgb-fx-base.yaml

properties:
  duration:
    type: int
    default: 1000
    description: |
      Approximate ripple travel time in milliseconds.

  color:
    type: int
    required: true
    description: |
      Ripple color in HSL format.

  buffer-size:
    type: int
    default: 10
    description: |
      This will limit how many keystroke events the effect is able to track
      at the same time. Depending on how fast you type and the effect duration
      you might need to increase this number.

  ripple-width:
    type: int
    default: 25
    description: |
      This setting determines the thickness of the ripple 'ring'.
      Think of it as antialiasing. The further apart the pixels are, or if they're
      spaced irregularly, the larger this number should be. Otherwise the effect
      will look uneven or LEDs might not light up at all.
      This effect is especially pronounced when lowering the effect duration or running
      low FPS.
```

## dts/bindings/zmk,rgb-fx-solid.yaml
```yaml
# Copyright (c) 2024 Kuba Birecki
# SPDX-License-Identifier: MIT

description: |
  Displays a solid color across the entire area

compatible: "zmk,rgb-fx-solid"

include: rgb-fx-base.yaml

properties:
  duration:
    type: int
    default: 5
    description: |
      Effect duration in seconds.
      This is the time it takes for the animation to complete a full cycle and return to the original color.
      Ignored if only a single color is given.

  colors:
    type: array
    required: true
    description: |
      The colors to cycle through during the animation in HSL format.
```

## dts/bindings/zmk,rgb-fx-sparkle.yaml
```yaml
# Copyright (c) 2024 Kuba Birecki
# SPDX-License-Identifier: MIT

description: |
  Displays a sparkle effect across the given pixels

compatible: "zmk,rgb-fx-sparkle"

include: rgb-fx-base.yaml

properties:
  duration:
    type: int
    default: 5
    description: |
      Effect duration in seconds. This is the maximum duration for the fade-in effect of a single 'spark'.
      A complete fade-in and fade-out cycle is randomized and can take up to twice this amount.

  colors:
    type: array
    required: true
    description: |
      Sparkle color in HSL format. If two colors are given, the effect will use HSL-interpolation
      between the two values to determine a random color for each sparkle.
```

## dts/bindings/zmk,rgb-fx-static.yaml
```yaml
# Copyright (c) 2024 Kuba Birecki
# SPDX-License-Identifier: MIT

description: |
  Assign a static color to each pixel

compatible: "zmk,rgb-fx-static"

include: rgb-fx-base.yaml

properties:
  colors:
    type: array
    required: true
    description: |
      The colors for each pixel in the zone in HSL format.
```

## dts/bindings/zmk,rgb-fx-wpm.yaml
```yaml
# Copyright (c) 2024 Kuba Birecki
# SPDX-License-Identifier: MIT

description: |
  Indicates the current typing speed in real-time by applying the specified
  colors over the specified area, relative to the indicated and maximum WPM values.

compatible: "zmk,rgb-fx-wpm"

include: rgb-fx-base.yaml

properties:
  max-wpm:
    type: int
    default: 100
    description: |
      The maximum saturation (100%) words-per-minute value.

  colors:
    type: array
    required: true
    description: |
      The colors to indicate the minimum and maximum typing speed in HSL format.
      It's possible to specify a single color in case you want it to remain unchanged
      regardless of the current WPM value.

  bounds:
    type: array
    default: [0, 255]
    description: |
      Set the minimum and maximum coordinates for which the animation shoould apply
      relative to the current WPM value.

  bounds-axis:
    type: string
    enum:
      - "horizontal"
      - "vertical"
    default: "horizontal"
    description: |
      The axis along which the bounds are applied.
      If set to "horizontal", the bounds will be applied along the X axis.
      If set to "vertical", the bounds will be applied along the Y axis.
```
